## boards/shields/Kconfig.shield
```kconfig
# Copyright (c) 2020 The ZMK Contributors
# SPDX-License-Identifier: MIT
#include <dt-bindings/zmk/outputs.h>

&out OUT_USB

config SHIELD_ERGODASH_LEFT
    def_bool $(shields_list_contains,ergodash_left)

config SHIELD_ERGODASH_RIGHT
    def_bool $(shields_list_contains,ergodash_right)
```

## boards/shields/e-wing/Kconfig.defconfig
```kconfig
# Copyright (c) 2020 The ZMK Contributors
# SPDX-License-Identifier: MIT

if SHIELD_E-WING_LEFT

config ZMK_KEYBOARD_NAME
    default "E-Wing"

config ZMK_SPLIT_ROLE_CENTRAL
    default y

endif

if SHIELD_E-WING_LEFT || SHIELD_E-WING_RIGHT

config ZMK_SPLIT
    default y

endif
```

## boards/shields/e-wing/Kconfig.shield
```kconfig
# Copyright (c) 2020 The ZMK Contributors
# SPDX-License-Identifier: MIT

config SHIELD_E-WING_LEFT
    def_bool $(shields_list_contains,e-wing_left)

config SHIELD_E-WING_RIGHT
    def_bool $(shields_list_contains,e-wing_right)
```
